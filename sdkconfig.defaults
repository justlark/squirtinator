## sdkconfig.defaults
```kconfig
# Rust often needs a bit of an extra main task stack size compared to C (the default is 3K)
CONFIG_ESP_MAIN_TASK_STACK_SIZE=8000

# The maximum size of the HTTP request headers section that can be processed by
# the server. The default is quite small.
CONFIG_HTTPD_MAX_REQ_HDR_LEN=1024
```
